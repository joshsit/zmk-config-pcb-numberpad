## boards/shields/pcb-numberpad/Kconfig.defconfig
```kconfig
if SHIELD_PCB-NUMBERPAD

# Name must be less than 16 characters long!
config ZMK_KEYBOARD_NAME
    default "pcb-numberpad"

endif
```

## boards/shields/pcb-numberpad/Kconfig.shield
```kconfig
# No whitespace after the comma or in your keyboard name!
config SHLIED_PCB-NUMBERPAD
    def_bool $(shields_list_contains,pcb-numberpad)
```

## boards/shields/pcbnumberpad/Kconfig.defconfig
```kconfig
if SHIELD_PCBNUMBERPAD

# Name must be less than 16 characters long!
config ZMK_KEYBOARD_NAME
    default "Numbpad"

endif
```

## boards/shields/pcbnumberpad/Kconfig.shield
```kconfig
# No whitespace after the comma or in your keyboard name!
config SHIELD_PCBNUMBERPAD
    def_bool $(shields_list_contains,pcbnumberpad)
```
